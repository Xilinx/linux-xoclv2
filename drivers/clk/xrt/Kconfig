## drivers/clk/xrt/Kconfig
```kconfig
# SPDX-License-Identifier: GPL-2.0

config XRT_CLK_WIZ
	tristate "Clock driver for Xilinx Alveo clocking wizard"
	depends on FPGA_XRT_LIB
	select XRT_CLK_FREQ
	select XRT_CLK_UCS
	help
	  Select this option to enable the Alveo clock controller driver.

config XRT_CLK_FREQ
	tristate "Driver for Xilinx Alveo clock frequency counter"
	depends on FPGA_XRT_LIB
	depends on XRT_CLK_WIZ
	help
	  Select this option to enable the Alveo clock frequency counter driver.

config XRT_CLK_UCS
	tristate "Driver for Xilinx Alveo user clock subsystem controller"
	depends on FPGA_XRT_LIB
	depends on XRT_CLK_WIZ
	help
	  Select this option to enable the Alveo user clock subsystem controller driver.
```

## drivers/fpga/alveo/Kconfig
```kconfig
# SPDX-License-Identifier: GPL-2.0-only
#
# Xilinx Alveo FPGA device configuration
#

source "drivers/fpga/alveo/mgmt/Kconfig"
source "drivers/fpga/alveo/lib/Kconfig"
```

## drivers/fpga/alveo/lib/Kconfig
```kconfig
# SPDX-License-Identifier: GPL-2.0-only
#
# Xilinx Alveo FPGA device configuration
#

config FPGA_ALVEO_LIB
	tristate "Xilinx Alveo Driver Library"
	depends on HWMON && PCI 
	select LIBFDT
	help
	  Xilinx Alveo FPGA PCIe device driver common library.
```

## drivers/fpga/alveo/mgmt/Kconfig
```kconfig
# SPDX-License-Identifier: GPL-2.0-only
#
# Xilinx Alveo FPGA device configuration
#

config FPGA_ALVEO_XMGMT
	tristate "Xilinx Alveo Management Driver"
	depends on HWMON && PCI && FPGA_ALVEO_LIB
	select LIBFDT
	help
	  Xilinx Alveo FPGA PCIe device driver for Management Physical Function.
```

## drivers/fpga/xrt/lib/Kconfig
```kconfig
# SPDX-License-Identifier: GPL-2.0-only
#
# XRT Alveo FPGA device configuration
#

config FPGA_XRT_LIB
	tristate "XRT Alveo Driver Library"
	depends on HWMON && PCI
	select LIBFDT
	help
	  XRT Alveo FPGA PCIe device driver common library.
```

## drivers/fpga/xrt/mgmt/Kconfig
```kconfig
# SPDX-License-Identifier: GPL-2.0-only
#
# Xilinx XRT FPGA device configuration
#

config FPGA_XRT_XMGMT
	tristate "Xilinx Alveo Management Driver"
	depends on HWMON && PCI && FPGA_XRT_LIB
	select LIBFDT
	help
	  XRT Alveo FPGA PCIe device driver for Management Physical Function.
```
